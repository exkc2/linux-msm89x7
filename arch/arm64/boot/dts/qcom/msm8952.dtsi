
#include "msm8939.dtsi"

&gcc{
compatible = "qcom,gcc-msm8952";                                     
};

&usb {
	reg =<0x78db000 0x200>,<0x78db200 0x200>;
};

&usb_hs_phy {
	qcom,init-seq = /bits/ 8 <0x0 0x73>,
				 <0x1 0x68>,
				 <0x2 0x24>;
};
